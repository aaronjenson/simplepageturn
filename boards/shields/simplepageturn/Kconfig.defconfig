## boards/shields/simplepageturn/Kconfig.defconfig
```kconfig
if SHIELD_SIMPLEPAGETURN

config ZMK_KEYBOARD_NAME
    default "pageturn"

endif
```

## boards/shields/simplepageturn/Kconfig.shield
```kconfig
config SHIELD_SIMPLEPAGETURN
    def_bool $(shields_list_contains,simplepageturn)
```
