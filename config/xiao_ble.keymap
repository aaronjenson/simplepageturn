 #include <behaviors.dtsi>
 #include <dt-bindings/zmk/keys.h>
 #include <dt-bindings/zmk/bt.h>

/ {
    keymap {
        compatible = "zmk,keymap";

        default_layer {
            bindings = <
                &mt PG_UP PG_DN    // Button 1 (D0): Next Page on tap, Prev Page on hold
            >;
        };
    };
};

&mt {
    tapping-term-ms = <500>;
};
